## drivers/button/Kconfig
```kconfig
menuconfig BUTTON
	bool "User Button Display Driver"
	depends on GPIO
	help
	  Enable User Button Display Driver.
```

## drivers/display/pcf8574/Kconfig
```kconfig
menuconfig PCF8574
	bool "PCF8574 I2C Display Driver"
	depends on I2C
	help
	  Enable PCF8574 I2C Display Driver.
	  
if PCF8574
	config PCF8553_ADDRESS
	hex "Device Address"
	default 0x7
	help 
		Every chip has three pins to setup between 8 different addresses
endif #PCF8574
```

## dts/bindings/sensor/i14,button.yaml
```yaml
description: User button i14

compatible: "i14,button"

include: base.yaml

properties:
    int-gpios:
      type: phandle-array
      required: false
      description: |
        Connection for the NIRQ signal.  This signal is active-low when
        produced by the sensor.
```

## west.yml
```yaml
manifest:
    defaults:
      remote: zephyrproject
    
    remotes:
        - name: nucleo-f207zg-zephyr
          url-base: https://github.com/icatorze/nucleo-f207zg-zephyr
        - name: zephyrproject
          url-base: https://github.com/zephyrproject-rtos
          
    projects:
        - name: zephyr
          path: zephyr
          west-commands: scripts/west-commands.yml
          remote: zephyrproject
          revision: master
        - name: cmsis
          revision: c3bd2094f92d574377f7af2aec147ae181aa5f8e
          path: modules/hal/cmsis
        - name: fatfs
          revision: 1d1fcc725aa1cb3c32f366e0c53d7490d0fe1109
          path: modules/fs/fatfs
        - name: hal_st
          revision: b52fdbf4b62439be9fab9bb4bae9690a42d2fb14
          path: modules/hal/st
        - name: hal_stm32
          revision: 68bfdabe97aa60934e1519e98593abaa9745501e
          path: modules/hal/stm32
        - name: libmetal
          revision: 9d4ee2c3cfd5f49861939447990f3b7d7bf9bf94
          path: modules/hal/libmetal
        - name: hal_quicklogic
          repo-path: hal_quicklogic
          revision: b3a66fe6d04d87fd1533a5c8de51d0599fcd08d0
          path: modules/hal/quicklogic
        - name: lvgl
          revision: 31acbaa36e9e74ab88ac81e3d21e7f1d00a71136
          path: modules/lib/gui/lvgl
        - name: mbedtls
          revision: 53044168b43f06ec5654b906a2cdd260bf477edd
          path: modules/crypto/mbedtls
        - name: mcuboot
          revision: 5f004461f9ad4041080a1975f58b043aa3031b65
          path: bootloader/mcuboot
        - name: mcumgr
          revision: 9f09bae7c0ad7df5e0a72731061125913fba61c7
          path: modules/lib/mcumgr
        - name: net-tools
          revision: f49bd1354616fae4093bf36e5eaee43c51a55127
          path: tools/net-tools
        - name: openthread
          revision: fd27fc3a7758d409e00d0e8d43f3f8364ce6c7e9
          path: modules/lib/openthread
        - name: segger
          revision: 38c79a447e4a47d413b4e8d34448316a5cece77c
          path: modules/debug/segger
        - name: sof
          url: https://github.com/nordic-krch/sof
          revision: 2f8ef204454d278f0c189e8c7cc70e84f745561a
          path: modules/audio/sof
        - name: tinycbor
          path: modules/lib/tinycbor
          revision: 40daca97b478989884bffb5226e9ab73ca54b8c4
        - name: tinycrypt
          path: modules/crypto/tinycrypt
          revision: 3e9a49d2672ec01435ffbf0d788db6d95ef28de0
        - name: littlefs
          path: modules/fs/littlefs
          revision: 9e4498d1c73009acd84bb36036ee5e2869112a6c
        - name: mipi-sys-t
          path: modules/debug/mipi-sys-t
          revision: 75e671550ac1acb502f315fe4952514dc73f7bfb
        - name: nrf_hw_models
          path: modules/bsim_hw_models/nrf_hw_models
          revision: a47e326ca772ddd14cc3b9d4ca30a9ab44ecca16
        - name: edtt
          path: tools/edtt
          revision: 7dd56fc100d79cc45c33d43e7401d1803e26f6e7
        - name: trusted-firmware-m
          path: modules/tee/tfm
          revision: 2c2aa3724a040233095a5c41ab79c8ad36134c8e
        - name: tfm-mcuboot # This is used by the trusted-firmware-m module.
          repo-path: mcuboot
          path: modules/tee/tfm-mcuboot
          revision: v1.7.2
          
    self:
        path: nucleo-f207zg-zephyr
```
